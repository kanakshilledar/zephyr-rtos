## sample.yaml
```
sample:
  description: LVGL sample application
  name: lvgl
tests:
  sample.display.lvgl.gui:
    filter: dt_chosen_enabled("zephyr,display")
    # flash usage varies depending on the platform, but ~200K are the bare
    # minimum, give some room by adding 50K more. RAM usage depends largerly on
    # the display buffer, but a minimum is also required for the system itself.
    # ~25K seem to be sufficient for most cases, rounded to 32K.
    min_flash: 250
    min_ram: 32
    harness: none
    tags:
      - samples
      - display
      - gui
<<<<<<< HEAD
=======
      - lvgl
>>>>>>> 01478ffa5f76283e4556b4b7585875d50d82484d
    modules:
      - lvgl
    integration_platforms:
      - native_posix_64
<<<<<<< HEAD
=======
  sample.display.lvgl.rk055hdmipi4m:
    # This sample is intended to test the RT1170 and RT595, which require
    # a display shield to work with LVGL
    min_flash: 250
    # The minimum RAM needed for this display is actually around 8MB,
    # but the RT595 uses external PSRAM for the display buffer
    min_ram: 32
    harness: none
    tags:
      - samples
      - display
      - gui
    modules:
      - lvgl
    extra_args: SHIELD="rk055hdmipi4m"
    platform_allow:
      - mimxrt1170_evk_cm7
      - mimxrt595_evk_cm33
    integration_platforms:
      - mimxrt1170_evk_cm7
>>>>>>> 01478ffa5f76283e4556b4b7585875d50d82484d
```

## prj.conf
```kconfig
<<<<<<< HEAD
CONFIG_LV_Z_MEM_POOL_NUMBER_BLOCKS=8
=======
CONFIG_LV_Z_MEM_POOL_SIZE=16384
CONFIG_LV_Z_SHELL=y
>>>>>>> 01478ffa5f76283e4556b4b7585875d50d82484d
CONFIG_MAIN_STACK_SIZE=2048

CONFIG_DISPLAY=y
CONFIG_DISPLAY_LOG_LEVEL_ERR=y

CONFIG_LOG=y
<<<<<<< HEAD
=======
CONFIG_SHELL=y
>>>>>>> 01478ffa5f76283e4556b4b7585875d50d82484d

CONFIG_LVGL=y
CONFIG_LV_MEM_CUSTOM=y
CONFIG_LV_USE_LOG=y
CONFIG_LV_USE_LABEL=y
CONFIG_LV_USE_BTN=y
<<<<<<< HEAD
CONFIG_LV_USE_IMG=y
=======
CONFIG_LV_USE_ARC=y
CONFIG_LV_USE_IMG=y
CONFIG_LV_USE_MONKEY=y
>>>>>>> 01478ffa5f76283e4556b4b7585875d50d82484d
CONFIG_LV_FONT_MONTSERRAT_14=y
```

## boards/native_posix.conf
```kconfig
CONFIG_LV_COLOR_DEPTH_32=y
CONFIG_GPIO=y
<<<<<<< HEAD
CONFIG_KSCAN=y
CONFIG_INPUT=y
CONFIG_LV_Z_POINTER_KSCAN=y
=======
CONFIG_INPUT=y
>>>>>>> 01478ffa5f76283e4556b4b7585875d50d82484d
```

## boards/native_posix.overlay
```dts
/*
 * Copyright (c) 2022, Basalte bv
 *
 * SPDX-License-Identifier: Apache-2.0
 */

<<<<<<< HEAD
=======
#include <zephyr/dt-bindings/input/input-event-codes.h>
>>>>>>> 01478ffa5f76283e4556b4b7585875d50d82484d

/ {
	aliases {
		sw0 = &button0;
	};

<<<<<<< HEAD
	keys {
=======
	qdec {
		compatible = "gpio-qdec";
		gpios = <&gpio0 4 GPIO_ACTIVE_HIGH>, <&gpio0 5 GPIO_ACTIVE_HIGH>;
		steps-per-period = <4>;
		zephyr,axis = <INPUT_REL_WHEEL>;
		sample-time-us = <2000>;
		idle-timeout-ms = <200>;
	};

	keys: keys {
>>>>>>> 01478ffa5f76283e4556b4b7585875d50d82484d
		compatible = "gpio-keys";
		button0: button0 {
			/* gpio0 pin 0 is already aliased to led0 */
			gpios = <&gpio0 1 GPIO_ACTIVE_HIGH>;
<<<<<<< HEAD
		};
=======
			zephyr,code = <INPUT_KEY_0>;
		};

		button1: button1 {
			gpios = <&gpio0 2 GPIO_ACTIVE_HIGH>;
			zephyr,code = <INPUT_KEY_1>;
		};

		encoder_button: encoder_button {
			gpios = <&gpio0 3 GPIO_ACTIVE_HIGH>;
			zephyr,code = <INPUT_KEY_ENTER>;
		};
	};

	lvgl_button_input {
		compatible = "zephyr,lvgl-button-input";
		input = <&keys>;
		input-codes = <INPUT_KEY_1>;
		coordinates = <160 120>;
	};

	lvgl_encoder_input {
		compatible = "zephyr,lvgl-encoder-input";
		rotation-input-code = <INPUT_REL_WHEEL>;
		button-input-code = <INPUT_KEY_ENTER>;
>>>>>>> 01478ffa5f76283e4556b4b7585875d50d82484d
	};
};

&gpio0 {
<<<<<<< HEAD
	ngpios = <2>;
=======
	ngpios = <6>;
>>>>>>> 01478ffa5f76283e4556b4b7585875d50d82484d

	sdl_gpio {
		status = "okay";
		compatible = "zephyr,gpio-emul-sdl";
		/* Skip pin 0 with the unknown code 0 */
<<<<<<< HEAD
		scancodes = <0 21>;
=======
		scancodes = <0 21 5 30 31 32>;
>>>>>>> 01478ffa5f76283e4556b4b7585875d50d82484d
	};
};
```

## src/main.c
```c
/*
 * Copyright (c) 2018 Jan Van Winkel <jan.van_winkel@dxplore.eu>
 *
 * SPDX-License-Identifier: Apache-2.0
 */

#include <zephyr/device.h>
#include <zephyr/devicetree.h>
#include <zephyr/drivers/display.h>
#include <zephyr/drivers/gpio.h>
#include <lvgl.h>
#include <stdio.h>
#include <string.h>
#include <zephyr/kernel.h>
<<<<<<< HEAD
=======
#include <lvgl_input_device.h>
>>>>>>> 01478ffa5f76283e4556b4b7585875d50d82484d

#define LOG_LEVEL CONFIG_LOG_DEFAULT_LEVEL
#include <zephyr/logging/log.h>
LOG_MODULE_REGISTER(app);

static uint32_t count;

#ifdef CONFIG_GPIO
static struct gpio_dt_spec button_gpio = GPIO_DT_SPEC_GET_OR(
		DT_ALIAS(sw0), gpios, {0});
static struct gpio_callback button_callback;

static void button_isr_callback(const struct device *port,
				struct gpio_callback *cb,
				uint32_t pins)
{
	ARG_UNUSED(port);
	ARG_UNUSED(cb);
	ARG_UNUSED(pins);

	count = 0;
}
<<<<<<< HEAD
#endif
=======
#endif /* CONFIG_GPIO */

#ifdef CONFIG_LV_Z_ENCODER_INPUT
static const struct device *lvgl_encoder =
	DEVICE_DT_GET(DT_COMPAT_GET_ANY_STATUS_OKAY(zephyr_lvgl_encoder_input));
#endif /* CONFIG_LV_Z_ENCODER_INPUT */

static void lv_btn_click_callback(lv_event_t *e)
{
	ARG_UNUSED(e);

	count = 0;
}
>>>>>>> 01478ffa5f76283e4556b4b7585875d50d82484d

int main(void)
{
	char count_str[11] = {0};
	const struct device *display_dev;
	lv_obj_t *hello_world_label;
	lv_obj_t *count_label;

	display_dev = DEVICE_DT_GET(DT_CHOSEN(zephyr_display));
	if (!device_is_ready(display_dev)) {
		LOG_ERR("Device not ready, aborting test");
		return 0;
	}

#ifdef CONFIG_GPIO
<<<<<<< HEAD
	if (device_is_ready(button_gpio.port)) {
=======
	if (gpio_is_ready_dt(&button_gpio)) {
>>>>>>> 01478ffa5f76283e4556b4b7585875d50d82484d
		int err;

		err = gpio_pin_configure_dt(&button_gpio, GPIO_INPUT);
		if (err) {
			LOG_ERR("failed to configure button gpio: %d", err);
			return 0;
		}

		gpio_init_callback(&button_callback, button_isr_callback,
				   BIT(button_gpio.pin));

		err = gpio_add_callback(button_gpio.port, &button_callback);
		if (err) {
			LOG_ERR("failed to add button callback: %d", err);
			return 0;
		}

		err = gpio_pin_interrupt_configure_dt(&button_gpio,
						      GPIO_INT_EDGE_TO_ACTIVE);
		if (err) {
			LOG_ERR("failed to enable button callback: %d", err);
			return 0;
		}
	}
<<<<<<< HEAD
#endif

	if (IS_ENABLED(CONFIG_LV_Z_POINTER_KSCAN)) {
=======
#endif /* CONFIG_GPIO */

#ifdef CONFIG_LV_Z_ENCODER_INPUT
	lv_obj_t *arc;
	lv_group_t *arc_group;

	arc = lv_arc_create(lv_scr_act());
	lv_obj_align(arc, LV_ALIGN_CENTER, 0, 0);
	lv_obj_set_size(arc, 150, 150);

	arc_group = lv_group_create();
	lv_group_add_obj(arc_group, arc);
	lv_indev_set_group(lvgl_input_get_indev(lvgl_encoder), arc_group);
#endif /* CONFIG_LV_Z_ENCODER_INPUT */

	if (IS_ENABLED(CONFIG_LV_Z_POINTER_KSCAN) || IS_ENABLED(CONFIG_LV_Z_POINTER_INPUT)) {
>>>>>>> 01478ffa5f76283e4556b4b7585875d50d82484d
		lv_obj_t *hello_world_button;

		hello_world_button = lv_btn_create(lv_scr_act());
		lv_obj_align(hello_world_button, LV_ALIGN_CENTER, 0, 0);
<<<<<<< HEAD
=======
		lv_obj_add_event_cb(hello_world_button, lv_btn_click_callback, LV_EVENT_CLICKED,
						NULL);
>>>>>>> 01478ffa5f76283e4556b4b7585875d50d82484d
		hello_world_label = lv_label_create(hello_world_button);
	} else {
		hello_world_label = lv_label_create(lv_scr_act());
	}

	lv_label_set_text(hello_world_label, "Hello world!");
	lv_obj_align(hello_world_label, LV_ALIGN_CENTER, 0, 0);

	count_label = lv_label_create(lv_scr_act());
	lv_obj_align(count_label, LV_ALIGN_BOTTOM_MID, 0, 0);

	lv_task_handler();
	display_blanking_off(display_dev);

	while (1) {
		if ((count % 100) == 0U) {
			sprintf(count_str, "%d", count/100U);
			lv_label_set_text(count_label, count_str);
		}
		lv_task_handler();
		++count;
		k_sleep(K_MSEC(10));
	}
}
```
