## Kconfig
```
# Private config options to the ISO-TP sample

# Copyright (c) 2023 Vestas Wind Systems A/S
# SPDX-License-Identifier: Apache-2.0

mainmenu "ISO-TP sample"

config SAMPLE_LOOPBACK_MODE
	bool "Use CAN loopback mode"
	help
	  Set the CAN controller to loopback mode. This allows testing without a second board.

<<<<<<< HEAD
=======
config SAMPLE_RX_THREAD_STACK_SIZE
	int "RX threads stack size"
	default 1024
	help
	  Stack size (in bytes) used for the RX threads.

config SAMPLE_RX_THREAD_PRIORITY
	int "RX threads priority"
	default 2
	help
	  Priority used for the RX threads.

config SAMPLE_CAN_FD_MODE
	bool "Use CAN-FD"
	select CAN_FD_MODE

config ISOTP_RX_BUF_COUNT
	default 4 if SAMPLE_CAN_FD_MODE
	default 2

>>>>>>> 01478ffa5f76283e4556b4b7585875d50d82484d
source "Kconfig.zephyr"
```

## sample.yaml
```
sample:
  name: ISO-TP sample
tests:
  sample.subsys.canbus.isotp:
    tags:
      - can
      - isotp
    depends_on: can
    filter: dt_chosen_enabled("zephyr,canbus") and not dt_compat_enabled("kvaser,pcican")
    extra_configs:
      - CONFIG_SAMPLE_LOOPBACK_MODE=y
    harness: console
    harness_config:
      type: one_line
      regex:
        - "(.*)Got 247 bytes in total"
<<<<<<< HEAD
=======
  sample.subsys.canbus.isotp.fd:
    tags:
      - can
      - isotp
    depends_on: can
    extra_configs:
      - CONFIG_SAMPLE_LOOPBACK_MODE=y
      - CONFIG_SAMPLE_CAN_FD_MODE=y
    platform_allow:
      - native_posix
      - native_posix_64
    harness: console
    harness_config:
      type: one_line
      regex:
        - "(.*)Got 247 bytes in total"
>>>>>>> 01478ffa5f76283e4556b4b7585875d50d82484d
```

## prj.conf
```kconfig
CONFIG_LOG=y

CONFIG_CAN=y
CONFIG_CAN_MAX_FILTER=8

CONFIG_ISOTP=y
<<<<<<< HEAD
CONFIG_ISOTP_RX_BUF_COUNT=2
#A frame has 7 bytes payload, we are using a BS of 8 and need one char for the
#string termination (7 * 8 + 1 = 57)
CONFIG_ISOTP_RX_BUF_SIZE=57
#We have two receiving contexts that are bound to a single address.
=======
# We have two receiving contexts that are bound to a single address.
>>>>>>> 01478ffa5f76283e4556b4b7585875d50d82484d
CONFIG_ISOTP_RX_SF_FF_BUF_COUNT=2
```

## src/main.c
```c
/*
 * Copyright (c) 2020 Alexander Wachter
 *
 * SPDX-License-Identifier: Apache-2.0
 */

#include <zephyr/kernel.h>
#include <zephyr/canbus/isotp.h>

<<<<<<< HEAD

#define RX_THREAD_STACK_SIZE 512
#define RX_THREAD_PRIORITY 2

=======
>>>>>>> 01478ffa5f76283e4556b4b7585875d50d82484d
const struct isotp_fc_opts fc_opts_8_0 = {.bs = 8, .stmin = 0};
const struct isotp_fc_opts fc_opts_0_5 = {.bs = 0, .stmin = 5};

const struct isotp_msg_id rx_addr_8_0 = {
	.std_id = 0x80,
<<<<<<< HEAD
	.ide = 0,
	.use_ext_addr = 0
};
const struct isotp_msg_id tx_addr_8_0 = {
	.std_id = 0x180,
	.ide = 0,
	.use_ext_addr = 0
};
const struct isotp_msg_id rx_addr_0_5 = {
	.std_id = 0x01,
	.ide = 0,
	.use_ext_addr = 0
};
const struct isotp_msg_id tx_addr_0_5 = {
	.std_id = 0x101,
	.ide = 0,
	.use_ext_addr = 0
=======
#ifdef CONFIG_SAMPLE_CAN_FD_MODE
	.flags = ISOTP_MSG_FDF | ISOTP_MSG_BRS,
#endif
};
const struct isotp_msg_id tx_addr_8_0 = {
	.std_id = 0x180,
#ifdef CONFIG_SAMPLE_CAN_FD_MODE
	.dl = 64,
	.flags = ISOTP_MSG_FDF | ISOTP_MSG_BRS,
#endif
};
const struct isotp_msg_id rx_addr_0_5 = {
	.std_id = 0x01,
#ifdef CONFIG_SAMPLE_CAN_FD_MODE
	.flags = ISOTP_MSG_FDF | ISOTP_MSG_BRS,
#endif
};
const struct isotp_msg_id tx_addr_0_5 = {
	.std_id = 0x101,
#ifdef CONFIG_SAMPLE_CAN_FD_MODE
	.dl = 64,
	.flags = ISOTP_MSG_FDF | ISOTP_MSG_BRS,
#endif
>>>>>>> 01478ffa5f76283e4556b4b7585875d50d82484d
};

const struct device *can_dev;
struct isotp_recv_ctx recv_ctx_8_0;
struct isotp_recv_ctx recv_ctx_0_5;

<<<<<<< HEAD
K_THREAD_STACK_DEFINE(rx_8_0_thread_stack, RX_THREAD_STACK_SIZE);
K_THREAD_STACK_DEFINE(rx_0_5_thread_stack, RX_THREAD_STACK_SIZE);
=======
K_THREAD_STACK_DEFINE(rx_8_0_thread_stack, CONFIG_SAMPLE_RX_THREAD_STACK_SIZE);
K_THREAD_STACK_DEFINE(rx_0_5_thread_stack, CONFIG_SAMPLE_RX_THREAD_STACK_SIZE);
>>>>>>> 01478ffa5f76283e4556b4b7585875d50d82484d
struct k_thread rx_8_0_thread_data;
struct k_thread rx_0_5_thread_data;

const char tx_data_large[] =
"========================================\n"
"|   ____  ___  ____       ____  ____   |\n"
"|  |_  _|/ __||    | ___ |_  _||  _ \\  |\n"
"|   _||_ \\__ \\| || | ___   ||  | ___/  |\n"
"|  |____||___/|____|       ||  |_|     |\n"
"========================================\n";

const char tx_data_small[] = "This is the sample test for the short payload\n";

void rx_8_0_thread(void *arg1, void *arg2, void *arg3)
{
	ARG_UNUSED(arg1);
	ARG_UNUSED(arg2);
	ARG_UNUSED(arg3);
	int ret, rem_len, received_len;
	struct net_buf *buf;
<<<<<<< HEAD
	static uint8_t rx_buffer[7];

=======
>>>>>>> 01478ffa5f76283e4556b4b7585875d50d82484d

	ret = isotp_bind(&recv_ctx_8_0, can_dev,
			 &tx_addr_8_0, &rx_addr_8_0,
			 &fc_opts_8_0, K_FOREVER);
	if (ret != ISOTP_N_OK) {
		printk("Failed to bind to rx ID %d [%d]\n",
		       rx_addr_8_0.std_id, ret);
		return;
	}

	while (1) {
		received_len = 0;
		do {
			rem_len = isotp_recv_net(&recv_ctx_8_0, &buf,
						 K_MSEC(2000));
			if (rem_len < 0) {
				printk("Receiving error [%d]\n", rem_len);
				break;
			}

<<<<<<< HEAD
			received_len += buf->len;
			if (net_buf_tailroom(buf) >= 1) {
				net_buf_add_u8(buf, '\0');
				printk("%s", buf->data);
			} else if (buf->len == 6) {
				/* First frame does not have tailroom.*/
				memcpy(rx_buffer, buf->data, 6);
				rx_buffer[6] = '\0';
				printk("%s", rx_buffer);
			} else {
				printk("No tailroom for string termination\n");
			}
			net_buf_unref(buf);
=======
			while (buf != NULL) {
				received_len += buf->len;
				printk("%.*s", buf->len, buf->data);
				buf = net_buf_frag_del(NULL, buf);
			}
>>>>>>> 01478ffa5f76283e4556b4b7585875d50d82484d
		} while (rem_len);
		printk("Got %d bytes in total\n", received_len);
	}
}

void rx_0_5_thread(void *arg1, void *arg2, void *arg3)
{
	ARG_UNUSED(arg1);
	ARG_UNUSED(arg2);
	ARG_UNUSED(arg3);
	int ret, received_len;
	static uint8_t rx_buffer[32];

	ret = isotp_bind(&recv_ctx_0_5, can_dev,
			 &tx_addr_0_5, &rx_addr_0_5,
			 &fc_opts_0_5, K_FOREVER);
	if (ret != ISOTP_N_OK) {
		printk("Failed to bind to rx ID %d [%d]\n",
		       rx_addr_0_5.std_id, ret);
		return;
	}

	while (1) {
		received_len = isotp_recv(&recv_ctx_0_5, rx_buffer,
					  sizeof(rx_buffer)-1U, K_MSEC(2000));
		if (received_len < 0) {
			printk("Receiving error [%d]\n", received_len);
			continue;
		}

		rx_buffer[received_len] = '\0';
		printk("%s", rx_buffer);
	}
}

void send_complette_cb(int error_nr, void *arg)
{
	ARG_UNUSED(arg);
	printk("TX complete cb [%d]\n", error_nr);
}

/**
 * @brief Main application entry point.
 *
 */
int main(void)
{
	k_tid_t tid;
	static struct isotp_send_ctx send_ctx_8_0;
	static struct isotp_send_ctx send_ctx_0_5;
	int ret = 0;

	can_dev = DEVICE_DT_GET(DT_CHOSEN(zephyr_canbus));
	if (!device_is_ready(can_dev)) {
		printk("CAN: Device driver not ready.\n");
		return 0;
	}

<<<<<<< HEAD
#ifdef CONFIG_SAMPLE_LOOPBACK_MODE
	ret = can_set_mode(can_dev, CAN_MODE_LOOPBACK);
	if (ret != 0) {
		printk("CAN: Failed to set loopback mode [%d]", ret);
		return 0;
	}
#endif /* CONFIG_SAMPLE_LOOPBACK_MODE */
=======
	can_mode_t mode = (IS_ENABLED(CONFIG_SAMPLE_LOOPBACK_MODE) ? CAN_MODE_LOOPBACK : 0) |
			  (IS_ENABLED(CONFIG_SAMPLE_CAN_FD_MODE) ? CAN_MODE_FD : 0);
	ret = can_set_mode(can_dev, mode);
	if (ret != 0) {
		printk("CAN: Failed to set mode [%d]", ret);
		return 0;
	}
>>>>>>> 01478ffa5f76283e4556b4b7585875d50d82484d

	ret = can_start(can_dev);
	if (ret != 0) {
		printk("CAN: Failed to start device [%d]\n", ret);
		return 0;
	}

	tid = k_thread_create(&rx_8_0_thread_data, rx_8_0_thread_stack,
			      K_THREAD_STACK_SIZEOF(rx_8_0_thread_stack),
			      rx_8_0_thread, NULL, NULL, NULL,
<<<<<<< HEAD
			      RX_THREAD_PRIORITY, 0, K_NO_WAIT);
	if (!tid) {
		printk("ERROR spawning rx thread\n");
	}
=======
			      CONFIG_SAMPLE_RX_THREAD_PRIORITY, 0, K_NO_WAIT);
	if (!tid) {
		printk("ERROR spawning rx thread\n");
		return 0;
	}
	k_thread_name_set(tid, "rx_8_0");
>>>>>>> 01478ffa5f76283e4556b4b7585875d50d82484d

	tid = k_thread_create(&rx_0_5_thread_data, rx_0_5_thread_stack,
			      K_THREAD_STACK_SIZEOF(rx_0_5_thread_stack),
			      rx_0_5_thread, NULL, NULL, NULL,
<<<<<<< HEAD
			      RX_THREAD_PRIORITY, 0, K_NO_WAIT);
	if (!tid) {
		printk("ERROR spawning rx thread\n");
	}
=======
			      CONFIG_SAMPLE_RX_THREAD_PRIORITY, 0, K_NO_WAIT);
	if (!tid) {
		printk("ERROR spawning rx thread\n");
		return 0;
	}
	k_thread_name_set(tid, "rx_0_5");
>>>>>>> 01478ffa5f76283e4556b4b7585875d50d82484d

	printk("Start sending data\n");

	while (1) {
		k_msleep(1000);
		ret = isotp_send(&send_ctx_0_5, can_dev,
				 tx_data_small, sizeof(tx_data_small),
				 &tx_addr_0_5, &rx_addr_0_5,
				 send_complette_cb, NULL);
		if (ret != ISOTP_N_OK) {
			printk("Error while sending data to ID %d [%d]\n",
			       tx_addr_0_5.std_id, ret);
		}

		ret = isotp_send(&send_ctx_8_0, can_dev,
				 tx_data_large, sizeof(tx_data_large),
				 &tx_addr_8_0, &rx_addr_8_0, NULL, NULL);
		if (ret != ISOTP_N_OK) {
			printk("Error while sending data to ID %d [%d]\n",
			       tx_addr_8_0.std_id, ret);
		}
	}
}
```
