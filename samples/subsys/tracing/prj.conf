## sample.yaml
```
common:
  tags:
    - tracing
    - debug
  harness: console
  harness_config:
    type: multi_line
    regex:
      - "thread_a: Hello World from (.*)!"
      - "thread_b: Hello World from (.*)!"
tests:
  sample.tracing.user:
    extra_args: CONF_FILE="prj_user.conf"
    integration_platforms:
      - qemu_x86
<<<<<<< HEAD
=======
    platform_exclude:
      - mr_canhubk3
    harness_config:
      type: multi_line
      regex:
        - "thread_a: Hello World from (.*)!"
        - "thread_b: Hello World from (.*)!"
        - "sys_trace_.*_user.*"
>>>>>>> 01478ffa5f76283e4556b4b7585875d50d82484d
  sample.tracing.format.sysview:
    platform_allow:
      - nrf52840dk_nrf52840
      - mimxrt1050_evk
      - mimxrt1064_evk
    integration_platforms:
      - nrf52840dk_nrf52840
    extra_args: CONF_FILE="prj_sysview.conf"
  sample.tracing.osawareness.openocd:
    arch_exclude:
      - posix
      - xtensa
    platform_exclude: qemu_x86_64
    integration_platforms:
      - qemu_x86
  sample.tracing.transport.uart:
    platform_allow:
      - qemu_x86
      - qemu_x86_64
    integration_platforms:
      - qemu_x86
    extra_args: CONF_FILE="prj_uart.conf"
    filter: dt_chosen_enabled("zephyr,tracing-uart")
  sample.tracing.transport.usb:
    platform_allow: sam_e70_xplained
    depends_on: usb_device
    extra_args: CONF_FILE="prj_usb.conf"
  sample.tracing.transport.uart.ctf:
    platform_allow:
      - qemu_x86
      - qemu_x86_64
    integration_platforms:
      - qemu_x86
    extra_args: CONF_FILE="prj_uart_ctf.conf"
    filter: dt_chosen_enabled("zephyr,tracing-uart")
  sample.tracing.transport.usb.ctf:
    platform_allow: sam_e70_xplained
    depends_on: usb_device
    extra_args: CONF_FILE="prj_usb_ctf.conf"
  sample.tracing.transport.native_posix:
    platform_allow: native_posix
  sample.tracing.transport.native_posix.ctf:
    platform_allow: native_posix
    extra_args: CONF_FILE="prj_native_posix_ctf.conf"
  sample.tracing.percepio:
    platform_allow: frdm_k64f
    extra_args: CONF_FILE="prj_percepio.conf"
    modules:
<<<<<<< HEAD
      - TraceRecorderSource
=======
      - percepio
>>>>>>> 01478ffa5f76283e4556b4b7585875d50d82484d
```

## prj.conf
```kconfig
# enable to use thread names
CONFIG_THREAD_NAME=y
CONFIG_MP_MAX_NUM_CPUS=1
<<<<<<< HEAD
=======

# Debugging
CONFIG_DEBUG_OPTIMIZATIONS=n
>>>>>>> 01478ffa5f76283e4556b4b7585875d50d82484d
CONFIG_DEBUG_THREAD_INFO=y
```

## prj_sysview.conf
```kconfig
CONFIG_TRACING=y
CONFIG_SEGGER_SYSTEMVIEW=y
CONFIG_IDLE_STACK_SIZE=2048
<<<<<<< HEAD
=======
CONFIG_SEGGER_SYSTEMVIEW_BOOT_ENABLE=n
CONFIG_SEGGER_SYSVIEW_POST_MORTEM_MODE=n
>>>>>>> 01478ffa5f76283e4556b4b7585875d50d82484d
```

## src/tracing_user.c
```c
/*
 * Copyright (c) 2020 Lexmark International, Inc.
 *
 * SPDX-License-Identifier: Apache-2.0
 */

#include <tracing_user.h>

<<<<<<< HEAD
void sys_trace_thread_switched_in_user(struct k_thread *thread)
{
	printk("%s: %p\n", __func__, thread);
}

void sys_trace_thread_switched_out_user(struct k_thread *thread)
{
	printk("%s: %p\n", __func__, thread);
}

void sys_trace_isr_enter_user(int nested_interrupts)
{
	printk("%s: %d\n", __func__, nested_interrupts);
}

void sys_trace_isr_exit_user(int nested_interrupts)
{
	printk("%s: %d\n", __func__, nested_interrupts);
=======
static int nested_interrupts[CONFIG_MP_MAX_NUM_CPUS];

void sys_trace_thread_switched_in_user(void)
{
	unsigned int key = irq_lock();

	__ASSERT_NO_MSG(nested_interrupts[_current_cpu->id] == 0);
	/* Can't use k_current_get as thread base and z_tls_current might be incorrect */
	printk("%s: %p\n", __func__, k_sched_current_thread_query());

	irq_unlock(key);
}

void sys_trace_thread_switched_out_user(void)
{
	unsigned int key = irq_lock();

	__ASSERT_NO_MSG(nested_interrupts[_current_cpu->id] == 0);
	/* Can't use k_current_get as thread base and z_tls_current might be incorrect */
	printk("%s: %p\n", __func__, k_sched_current_thread_query());

	irq_unlock(key);
}

void sys_trace_isr_enter_user(void)
{
	unsigned int key = irq_lock();
	_cpu_t *curr_cpu = _current_cpu;

	printk("%s: %d\n", __func__, nested_interrupts[curr_cpu->id]);
	nested_interrupts[curr_cpu->id]++;

	irq_unlock(key);
}

void sys_trace_isr_exit_user(void)
{
	unsigned int key = irq_lock();
	_cpu_t *curr_cpu = _current_cpu;

	nested_interrupts[curr_cpu->id]--;
	printk("%s: %d\n", __func__, nested_interrupts[curr_cpu->id]);

	irq_unlock(key);
>>>>>>> 01478ffa5f76283e4556b4b7585875d50d82484d
}

void sys_trace_idle_user(void)
{
	printk("%s\n", __func__);
}
```
