## boards/riscv/shakti/Kconfig.board
```kconfig
config BOARD_SHAKTI
	bool "shakti target"
	depends on SOC_RISCV32_SHAKTI
        select QEMU_TARGET
        select HAS_DTS
```

## boards/riscv/shakti/shakti_defconfig
```kconfig
CONFIG_RISCV32=y
CONFIG_SOC_SERIES_RISCV32_SHAKTI=y
CONFIG_SOC_RISCV32_SHAKTI=y
CONFIG_BOARD_SHAKTI=y
CONFIG_CONSOLE=y
CONFIG_PRINTK=y
CONFIG_SERIAL=y
CONFIG_UART_SHAKTI=y
CONFIG_UART_SHAKTI_PORT_0=y
CONFIG_UART_CONSOLE=y
CONFIG_RISCV_MACHINE_TIMER=y
CONFIG_PLIC=n
CONFIG_BOOT_BANNER=y
```

## boards/riscv/visionfive2_jh7110/Kconfig.board
```kconfig
# Copyright (c) 2021 Rajnesh Kanwal <rajnesh.kanwal49@gmail.com>
# SPDX-License-Identifier: Apache-2.0

config BOARD_VISIONFIVE2_JH7110
        bool "VISIONFIVE2 JH7110 RISCV64 target"
        depends on SOC_JH7110
        select 64BIT
```
