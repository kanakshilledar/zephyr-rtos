/dts-v1/;

#include <riscv32-shakti.dtsi>

/ {
	model = "shakti,spike-bare";
	compatible = "shakti,spike-bare-dev";

chosen {
		zephyr,console = &uart0;
	};


};

&uart0 {
	status = "okay";
	current-speed = <115200>;
	clock-frequency = <16000000>;
};