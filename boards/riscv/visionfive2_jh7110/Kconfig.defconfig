## boards/riscv/visionfive2_jh7110/Kconfig.defconfig
```kconfig
# Copyright (c) 2021 Rajnesh Kanwal <rajnesh.kanwal49@gmail.com>
# SPDX-License-Identifier: Apache-2.0

config BOARD
        default "visionfive2_jh7110"
        depends on BOARD_VISIONFIVE2_JH7110
```
