## soc/riscv/riscv-privileged/shakti/Kconfig.defconfig.series
```kconfig
if SOC_SERIES_RISCV32_SHAKTI

config SOC_SERIES
	string
	default "shakti"

config SYS_CLOCK_HW_CYCLES_PER_SEC
	int
	default 32768

config RISCV_SOC_INTERRUPT_INIT
	bool
	default y

config RISCV_HAS_CPU_IDLE
	bool
	default y

config NUM_IRQS
	int
	default 64

config RISCV_RAM_BASE_ADDR
	hex
	default	0x80000000

config RISCV_RAM_SIZE
	hex
	default 0x8000

endif # SOC_SERIES_RISCV32_SIFIVE_FREEDOM
```
