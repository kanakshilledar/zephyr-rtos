## prj.conf
```kconfig
# Networking config
CONFIG_NETWORKING=y
CONFIG_NET_TEST=y
CONFIG_NET_DRIVERS=y
CONFIG_NET_LOOPBACK=y
CONFIG_NET_IPV4=y
<<<<<<< HEAD
CONFIG_NET_IPV6=y
=======
>>>>>>> 01478ffa5f76283e4556b4b7585875d50d82484d
CONFIG_NET_SOCKETS=y
CONFIG_NET_SOCKETPAIR=y
CONFIG_NET_SOCKETPAIR_BUFFER_SIZE=64
CONFIG_NET_SOCKETS_POSIX_NAMES=y
<<<<<<< HEAD
# Defines fd_set size
CONFIG_POSIX_MAX_FDS=33
=======
>>>>>>> 01478ffa5f76283e4556b4b7585875d50d82484d

# Network driver config
CONFIG_TEST_RANDOM_GENERATOR=y

CONFIG_MAIN_STACK_SIZE=2048
CONFIG_ZTEST=y
CONFIG_ZTEST_NEW_API=y

# User mode requirements
CONFIG_TEST_USERSPACE=y
CONFIG_HEAP_MEM_POOL_SIZE=2048
```

## src/_main.c
```c
/*
 * Copyright (c) 2020 Friedt Professional Engineering Services, Inc
 *
 * SPDX-License-Identifier: Apache-2.0
 */

<<<<<<< HEAD
#include <zephyr/logging/log.h>
#include <zephyr/ztest.h>

LOG_MODULE_REGISTER(net_test, CONFIG_NET_SOCKETS_LOG_LEVEL);

static void *setup(void)
{
	k_thread_system_pool_assign(k_current_get());
	return NULL;
}

ZTEST_SUITE(net_socketpair, NULL, setup, NULL, NULL, NULL);
=======
#include "_main.h"

#include <zephyr/logging/log.h>
#include <zephyr/net/socket.h>
#include <zephyr/ztest.h>

static ZTEST_DMEM struct net_socketpair_fixture fixture;
static void *setup(void)
{
	k_thread_system_pool_assign(k_current_get());

	return &fixture;
}

static void before(void *arg)
{
	struct net_socketpair_fixture *fixture = arg;

	for (int i = 0; i < 2; ++i) {
		if (fixture->sv[i] >= 0) {
			fixture->sv[i] = -1;
		}
	}
	zassert_ok(socketpair(AF_UNIX, SOCK_STREAM, 0, fixture->sv));
}

static void after(void *arg)
{
	struct net_socketpair_fixture *fixture = arg;

	for (int i = 0; i < 2; ++i) {
		if (fixture->sv[i] >= 0) {
			zassert_ok(close(fixture->sv[i]));
			fixture->sv[i] = -1;
		}
	}
}

ZTEST_SUITE(net_socketpair, NULL, setup, before, after, NULL);
>>>>>>> 01478ffa5f76283e4556b4b7585875d50d82484d
```

## src/_main.h
```c
/*
 * Copyright (c) 2020 Friedt Professional Engineering Services, Inc
 *
 * SPDX-License-Identifier: Apache-2.0
 */

#ifndef TEST_SOCKETPAIR_THREAD_H_
#define TEST_SOCKETPAIR_THREAD_H_

#include <errno.h>
#include <string.h>

#include <zephyr/logging/log.h>
#include <zephyr/net/socket.h>
#include <zephyr/posix/fcntl.h>
#include <zephyr/sys/util.h>
#include <zephyr/ztest.h>

LOG_MODULE_DECLARE(net_test, CONFIG_NET_SOCKETS_LOG_LEVEL);

<<<<<<< HEAD
extern struct k_work_q test_socketpair_work_q;
=======
struct net_socketpair_fixture {
	int sv[2];
};
>>>>>>> 01478ffa5f76283e4556b4b7585875d50d82484d

#endif /* TEST_SOCKETPAIR_THREAD_H_ */
```

## src/block.c
```c
/*
 * Copyright (c) 2020 Friedt Professional Engineering Services, Inc
 *
 * SPDX-License-Identifier: Apache-2.0
 */

#include "_main.h"

struct ctx {
	/* true if test is write_block(), false if test is read_block() */
	bool write;
	/* the secondary-side socket of the socketpair */
	int fd;
	/* the count of the main thread */
	atomic_t m;
};
static ZTEST_BMEM struct ctx ctx;
static ZTEST_BMEM struct k_work work;

<<<<<<< HEAD
static void work_handler(struct k_work *work)
=======
static void work_handler(struct k_work *w)
>>>>>>> 01478ffa5f76283e4556b4b7585875d50d82484d
{
	int res;
	char c = '\0';

<<<<<<< HEAD
=======
	(void)w;

>>>>>>> 01478ffa5f76283e4556b4b7585875d50d82484d
	LOG_DBG("doing work");

	while (true) {
		if (ctx.write) {
			LOG_DBG("ctx.m: %lu", atomic_get(&ctx.m));
			if (atomic_get(&ctx.m)
				< CONFIG_NET_SOCKETPAIR_BUFFER_SIZE) {
				continue;
			}
			LOG_DBG("ready to read!");
		} else {
			LOG_DBG("sleeping for 100ms..");
			k_sleep(K_MSEC(100));
			LOG_DBG("ready to write!");
		}
		break;
	}

	LOG_DBG("%sing 1 byte %s fd %d", ctx.write ? "read" : "writ",
		ctx.write ? "from" : "to", ctx.fd);
	if (ctx.write) {
		res = recv(ctx.fd, &c, 1, 0);
	} else {
		res = send(ctx.fd, "x", 1, 0);
	}
	if (-1 == res || 1 != res) {
		LOG_DBG("%s() failed: %d", ctx.write ? "recv" : "send", errno);
	} else {
		LOG_DBG("%s 1 byte", ctx.write ? "read" : "wrote");
	}
}

<<<<<<< HEAD
ZTEST(net_socketpair, test_write_block)
{
	int res;
	int sv[2] = {-1, -1};

	LOG_DBG("creating socketpair..");
	res = socketpair(AF_UNIX, SOCK_STREAM, 0, sv);
	zassert_equal(res, 0, "socketpair() failed: %d", errno);

	for (size_t i = 0; i < 2; ++i) {

		LOG_DBG("data direction %d -> %d", sv[i], sv[(!i) & 1]);
=======
ZTEST_F(net_socketpair, test_write_block)
{
	int res;

	for (size_t i = 0; i < 2; ++i) {

		LOG_DBG("data direction %d -> %d", fixture->sv[i], fixture->sv[(!i) & 1]);
>>>>>>> 01478ffa5f76283e4556b4b7585875d50d82484d

		LOG_DBG("setting up context");
		memset(&ctx, 0, sizeof(ctx));
		ctx.write = true;
<<<<<<< HEAD
		ctx.fd = sv[(!i) & 1];
=======
		ctx.fd = fixture->sv[(!i) & 1];
>>>>>>> 01478ffa5f76283e4556b4b7585875d50d82484d

		LOG_DBG("queueing work");
		k_work_init(&work, work_handler);
		k_work_submit(&work);

		/* fill up the buffer */
		for (ctx.m = 0; atomic_get(&ctx.m)
			< CONFIG_NET_SOCKETPAIR_BUFFER_SIZE;) {

<<<<<<< HEAD
			res = send(sv[i], "x", 1, 0);
=======
			res = send(fixture->sv[i], "x", 1, 0);
>>>>>>> 01478ffa5f76283e4556b4b7585875d50d82484d
			zassert_not_equal(res, -1, "send() failed: %d", errno);
			zassert_equal(res, 1, "wrote %d bytes instead of 1",
				res);

			atomic_inc(&ctx.m);
			LOG_DBG("have written %lu bytes", atomic_get(&ctx.m));
		}

		/* try to write one more byte */
<<<<<<< HEAD
		LOG_DBG("writing to fd %d", sv[i]);
		res = send(sv[i], "x", 1, 0);
=======
		LOG_DBG("writing to fd %d", fixture->sv[i]);
		res = send(fixture->sv[i], "x", 1, 0);
>>>>>>> 01478ffa5f76283e4556b4b7585875d50d82484d
		zassert_not_equal(res, -1, "send() failed: %d", errno);
		zassert_equal(res, 1, "wrote %d bytes instead of 1", res);

		LOG_DBG("success!");
	}
<<<<<<< HEAD

	close(sv[0]);
	close(sv[1]);
}

ZTEST(net_socketpair, test_read_block)
{
	int res;
	char x;
	int sv[2] = {-1, -1};

	LOG_DBG("creating socketpair..");
	res = socketpair(AF_UNIX, SOCK_STREAM, 0, sv);
	zassert_equal(res, 0, "socketpair() failed: %d", errno);

	for (size_t i = 0; i < 2; ++i) {

		LOG_DBG("data direction %d <- %d", sv[i], sv[(!i) & 1]);
=======
}

ZTEST_F(net_socketpair, test_read_block)
{
	int res;
	char x;

	for (size_t i = 0; i < 2; ++i) {

		LOG_DBG("data direction %d <- %d", fixture->sv[i], fixture->sv[(!i) & 1]);
>>>>>>> 01478ffa5f76283e4556b4b7585875d50d82484d

		LOG_DBG("setting up context");
		memset(&ctx, 0, sizeof(ctx));
		ctx.write = false;
<<<<<<< HEAD
		ctx.fd = sv[(!i) & 1];
=======
		ctx.fd = fixture->sv[(!i) & 1];
>>>>>>> 01478ffa5f76283e4556b4b7585875d50d82484d

		LOG_DBG("queueing work");
		k_work_init(&work, work_handler);
		k_work_submit(&work);

		/* try to read one byte */
<<<<<<< HEAD
		LOG_DBG("reading from fd %d", sv[i]);
		x = '\0';
		res = recv(sv[i], &x, 1, 0);
=======
		LOG_DBG("reading from fd %d", fixture->sv[i]);
		x = '\0';
		res = recv(fixture->sv[i], &x, 1, 0);
>>>>>>> 01478ffa5f76283e4556b4b7585875d50d82484d
		zassert_not_equal(res, -1, "recv() failed: %d", errno);
		zassert_equal(res, 1, "read %d bytes instead of 1", res);

		LOG_DBG("success!");
	}
<<<<<<< HEAD

	close(sv[0]);
	close(sv[1]);
=======
>>>>>>> 01478ffa5f76283e4556b4b7585875d50d82484d
}
```

## src/closed_ends.c
```c
/* SPDX-License-Identifier: Apache-2.0
 *
 * Copyright (c) 2020 Friedt Professional Engineering Services, Inc
 */

#include "_main.h"

<<<<<<< HEAD
ZTEST_USER(net_socketpair, test_close_one_end_and_write_to_the_other)
{
	int res;
	int sv[2] = {-1, -1};

	for (size_t i = 0; i < 2; ++i) {
		res = socketpair(AF_UNIX, SOCK_STREAM, 0, sv);
		zassert_equal(res, 0, "socketpair() failed: %d", errno);

		res = close(sv[i]);
		zassert_equal(res, 0, "close(sv[%u]) failed: %d", i, errno);

		res = send(sv[(!i) & 1], "x", 1, 0);
=======
ZTEST_USER_F(net_socketpair, test_close_one_end_and_write_to_the_other)
{
	int res;

	for (size_t i = 0; i < 2; ++i) {
		res = close(fixture->sv[i]);
		zassert_equal(res, 0, "close(fixture->sv[%u]) failed: %d", i, errno);
		fixture->sv[i] = -1;

		res = send(fixture->sv[(!i) & 1], "x", 1, 0);
>>>>>>> 01478ffa5f76283e4556b4b7585875d50d82484d
		zassert_equal(res, -1, "expected send() to fail");
		zassert_equal(res, -1, "errno: expected: EPIPE actual: %d",
			errno);

<<<<<<< HEAD
		res = close(sv[(!i) & 1]);
		zassert_equal(res, 0, "close(sv[%u]) failed: %d", i, errno);
	}
}

ZTEST_USER(net_socketpair, test_close_one_end_and_read_from_the_other)
{
	int res;
	int sv[2] = {-1, -1};
	char xx[16];

	for (size_t i = 0; i < 2; ++i) {
		res = socketpair(AF_UNIX, SOCK_STREAM, 0, sv);
		zassert_equal(res, 0, "socketpair() failed: %d", errno);

=======
		res = close(fixture->sv[(!i) & 1]);
		zassert_equal(res, 0, "close(fixture->sv[%u]) failed: %d", i, errno);
		fixture->sv[(!i) & 1] = -1;

		res = socketpair(AF_UNIX, SOCK_STREAM, 0, fixture->sv);
		zassert_equal(res, 0, "socketpair() failed: %d", errno);
	}
}

ZTEST_USER_F(net_socketpair, test_close_one_end_and_read_from_the_other)
{
	int res;
	char xx[16];

	for (size_t i = 0; i < 2; ++i) {
>>>>>>> 01478ffa5f76283e4556b4b7585875d50d82484d
		/* We want to write some bytes to the closing end of the
		 * socket before it gets shut down, so that we can prove that
		 * reading is possible from the other end still and that data
		 * is not lost.
		 */
<<<<<<< HEAD
		res = send(sv[i], "xx", 2, 0);
		zassert_not_equal(res, -1, "send() failed: %d", errno);
		zassert_equal(res, 2, "write() failed to write 2 bytes");

		res = close(sv[i]);
		zassert_equal(res, 0, "close(sv[%u]) failed: %d", i, errno);

		memset(xx, 0, sizeof(xx));
		res = recv(sv[(!i) & 1], xx, sizeof(xx), 0);
=======
		res = send(fixture->sv[i], "xx", 2, 0);
		zassert_not_equal(res, -1, "send() failed: %d", errno);
		zassert_equal(res, 2, "write() failed to write 2 bytes");

		res = close(fixture->sv[i]);
		zassert_equal(res, 0, "close(fixture->sv[%u]) failed: %d", i, errno);
		fixture->sv[i] = -1;

		memset(xx, 0, sizeof(xx));
		res = recv(fixture->sv[(!i) & 1], xx, sizeof(xx), 0);
>>>>>>> 01478ffa5f76283e4556b4b7585875d50d82484d
		zassert_not_equal(res, -1, "read() failed: %d", errno);
		zassert_equal(res, 2, "expected to read 2 bytes but read %d",
			res);

<<<<<<< HEAD
		res = recv(sv[(!i) & 1], xx, sizeof(xx), 0);
		zassert_equal(res, 0, "expected read() to succeed but read 0 bytes");

		res = close(sv[(!i) & 1]);
		zassert_equal(res, 0, "close(sv[%u]) failed: %d", i, errno);
=======
		res = recv(fixture->sv[(!i) & 1], xx, sizeof(xx), 0);
		zassert_equal(res, 0, "expected read() to succeed but read 0 bytes");

		res = close(fixture->sv[(!i) & 1]);
		zassert_equal(res, 0, "close(fixture->sv[%u]) failed: %d", i, errno);
		fixture->sv[(!i) & 1] = -1;

		res = socketpair(AF_UNIX, SOCK_STREAM, 0, fixture->sv);
		zassert_equal(res, 0, "socketpair() failed: %d", errno);
>>>>>>> 01478ffa5f76283e4556b4b7585875d50d82484d
	}
}
```

## src/expected_failures.c
```c
/*
 * Copyright (c) 2020 Friedt Professional Engineering Services, Inc
 *
 * SPDX-License-Identifier: Apache-2.0
 */

#include "_main.h"

<<<<<<< HEAD
ZTEST_USER(net_socketpair, test_expected_failures)
{
	int res;
	int sv[2] = {-1, -1};

	/* Use invalid values in fields starting from left to right */

	res = socketpair(AF_INET, SOCK_STREAM, 0, sv);
	if (res != -1) {
		close(sv[0]);
		close(sv[1]);
	}
	zassert_equal(res, -1, "socketpair with fail with bad address family");
	zassert_equal(errno, EAFNOSUPPORT,
				  "errno should be EAFNOSUPPORT with bad address family");

	res = socketpair(AF_UNIX, 42, 0, sv);
	if (res != -1) {
		close(sv[0]);
		close(sv[1]);
=======
ZTEST_USER_F(net_socketpair, test_expected_failures)
{
	int res;

	/* Use invalid values in fields starting from left to right */

	res = socketpair(AF_INET, SOCK_STREAM, 0, fixture->sv);
	if (res != -1) {
		for (int i = 0; i < 2; ++i) {
			zassert_ok(close(fixture->sv[i]));
			fixture->sv[i] = -1;
		}
	}
	zassert_equal(res, -1, "socketpair should fail with bad address family");
	zassert_equal(errno, EAFNOSUPPORT,
				  "errno should be EAFNOSUPPORT with bad address family");

	res = socketpair(AF_UNIX, 42, 0, fixture->sv);
	if (res != -1) {
		for (int i = 0; i < 2; ++i) {
			zassert_ok(close(fixture->sv[i]));
			fixture->sv[i] = -1;
		}
>>>>>>> 01478ffa5f76283e4556b4b7585875d50d82484d
	}
	zassert_equal(res, -1,
				  "socketpair should fail with unsupported socket type");
	zassert_equal(errno, EPROTOTYPE,
				  "errno should be EPROTOTYPE with bad socket type");

<<<<<<< HEAD
	res = socketpair(AF_UNIX, SOCK_STREAM, IPPROTO_TLS_1_0, sv);
	if (res != -1) {
		close(sv[0]);
		close(sv[1]);
=======
	res = socketpair(AF_UNIX, SOCK_STREAM, IPPROTO_TLS_1_0, fixture->sv);
	if (res != -1) {
		for (int i = 0; i < 2; ++i) {
			zassert_ok(close(fixture->sv[i]));
			fixture->sv[i] = -1;
		}
>>>>>>> 01478ffa5f76283e4556b4b7585875d50d82484d
	}
	zassert_equal(res, -1,
				  "socketpair should fail with unsupported protocol");
	zassert_equal(errno, EPROTONOSUPPORT,
				  "errno should be EPROTONOSUPPORT with bad protocol");

	/* This is not a POSIX requirement, but should be safe */
	res = socketpair(AF_UNIX, SOCK_STREAM, 0, NULL);
	if (res != -1) {
<<<<<<< HEAD
		close(sv[0]);
		close(sv[1]);
=======
		for (int i = 0; i < 2; ++i) {
			zassert_ok(close(fixture->sv[i]));
			fixture->sv[i] = -1;
		}
>>>>>>> 01478ffa5f76283e4556b4b7585875d50d82484d
	}
	zassert_equal(res, -1,
				  "socketpair should fail with invalid socket vector");
	zassert_equal(errno, EFAULT,
				  "errno should be EFAULT with bad socket vector");
}
```

## src/fcntl.c
```c
/*
 * Copyright (c) 2020 Friedt Professional Engineering Services, Inc
 *
 * SPDX-License-Identifier: Apache-2.0
 */

#include "_main.h"

<<<<<<< HEAD
ZTEST_USER(net_socketpair, test_fcntl)
{
	int res;
	int sv[2] = {-1, -1};
	int flags;

	res = socketpair(AF_UNIX, SOCK_STREAM, 0, sv);
	zassert_equal(res, 0,
		"socketpair(AF_UNIX, SOCK_STREAM, 0, sv) failed");

	res = fcntl(sv[0], F_GETFL, 0);
	zassert_not_equal(res, -1,
		"fcntl(sv[0], F_GETFL) failed. errno: %d", errno);
=======
ZTEST_USER_F(net_socketpair, test_fcntl)
{
	int res;
	int flags;

	res = fcntl(fixture->sv[0], F_GETFL, 0);
	zassert_not_equal(res, -1,
		"fcntl(fixture->sv[0], F_GETFL) failed. errno: %d", errno);
>>>>>>> 01478ffa5f76283e4556b4b7585875d50d82484d

	flags = res;
	zassert_equal(res & O_NONBLOCK, 0,
		"socketpair should block by default");

<<<<<<< HEAD
	res = fcntl(sv[0], F_SETFL, flags | O_NONBLOCK);
	zassert_not_equal(res, -1,
		"fcntl(sv[0], F_SETFL, flags | O_NONBLOCK) failed. errno: %d",
		errno);

	res = fcntl(sv[0], F_GETFL, 0);
	zassert_equal(res ^ flags, O_NONBLOCK, "expected O_NONBLOCK set");

	close(sv[0]);
	close(sv[1]);
=======
	res = fcntl(fixture->sv[0], F_SETFL, flags | O_NONBLOCK);
	zassert_not_equal(res, -1,
		"fcntl(fixture->sv[0], F_SETFL, flags | O_NONBLOCK) failed. errno: %d",
		errno);

	res = fcntl(fixture->sv[0], F_GETFL, 0);
	zassert_equal(res ^ flags, O_NONBLOCK, "expected O_NONBLOCK set");
>>>>>>> 01478ffa5f76283e4556b4b7585875d50d82484d
}
```

## src/happy_path.c
```c
/*
 * Copyright (c) 2020 Friedt Professional Engineering Services, Inc
 *
 * SPDX-License-Identifier: Apache-2.0
 */

#include "_main.h"

static void happy_path(
<<<<<<< HEAD
=======
	struct net_socketpair_fixture *fixture,
>>>>>>> 01478ffa5f76283e4556b4b7585875d50d82484d
	const int family, const char *family_s,
	const int type, const char *type_s,
	const int proto, const char *proto_s
)
{
	int res;
<<<<<<< HEAD
	int sv[2] = {-1, -1};
=======
>>>>>>> 01478ffa5f76283e4556b4b7585875d50d82484d

	const char *expected_msg = "Hello, socketpair(2) world!";
	const unsigned int expected_msg_len = strlen(expected_msg);
	char actual_msg[32];
	size_t actual_msg_len;
	struct iovec iovec;
	struct msghdr msghdr;
<<<<<<< HEAD

	LOG_DBG("calling socketpair(%u, %u, %u, %p)", family, type, proto, sv);
	res = socketpair(family, type, proto, sv);
	zassert_true(res == -1 || res == 0,
		     "socketpair returned an unspecified value");
	zassert_equal(res, 0, "socketpair failed");
	LOG_DBG("sv: {%d, %d}", sv[0], sv[1]);

=======
>>>>>>> 01478ffa5f76283e4556b4b7585875d50d82484d
	socklen_t len;

	/* sockets are bidirectional. test functions from both ends */
	for (int i = 0; i < 2; ++i) {

		/*
		 * Test with send() / recv()
		 */

<<<<<<< HEAD
		res = send(sv[i], expected_msg, expected_msg_len, 0);
=======
		res = send(fixture->sv[i], expected_msg, expected_msg_len, 0);
>>>>>>> 01478ffa5f76283e4556b4b7585875d50d82484d

		zassert_not_equal(res, -1, "send() failed: %d", errno);
		actual_msg_len = res;
		zassert_equal(actual_msg_len, expected_msg_len,
				  "did not send entire message");

		memset(actual_msg, 0, sizeof(actual_msg));

<<<<<<< HEAD
		res = recv(sv[(!i) & 1], actual_msg, sizeof(actual_msg), 0);
=======
		res = recv(fixture->sv[(!i) & 1], actual_msg, sizeof(actual_msg), 0);
>>>>>>> 01478ffa5f76283e4556b4b7585875d50d82484d

		zassert_not_equal(res, -1, "recv() failed: %d", errno);
		actual_msg_len = res;
		zassert_equal(actual_msg_len, expected_msg_len,
			      "wrong return value");

		zassert_true(strncmp(expected_msg, actual_msg,
			actual_msg_len) == 0,
			"the wrong message was passed through the socketpair");

		/*
		 * Test with sendto(2) / recvfrom(2)
		 */

<<<<<<< HEAD
		res = sendto(sv[i], expected_msg, expected_msg_len, 0, NULL, 0);
=======
		res = sendto(fixture->sv[i], expected_msg, expected_msg_len, 0, NULL, 0);
>>>>>>> 01478ffa5f76283e4556b4b7585875d50d82484d

		zassert_not_equal(res, -1, "sendto() failed: %d", errno);
		actual_msg_len = res;
		zassert_equal(actual_msg_len, expected_msg_len,
				  "did not sendto entire message");

		memset(actual_msg, 0, sizeof(actual_msg));

		len = 0;
<<<<<<< HEAD
		res = recvfrom(sv[(!i) & 1], actual_msg, sizeof(actual_msg), 0,
=======
		res = recvfrom(fixture->sv[(!i) & 1], actual_msg, sizeof(actual_msg), 0,
>>>>>>> 01478ffa5f76283e4556b4b7585875d50d82484d
			NULL, &len);
		zassert_true(res >= 0, "recvfrom() failed: %d", errno);
		actual_msg_len = res;
		zassert_equal(actual_msg_len, expected_msg_len,
			      "wrong return value");

		zassert_true(strncmp(expected_msg, actual_msg,
			actual_msg_len) == 0,
			"the wrong message was passed through the socketpair");

		/*
		 * Test with sendmsg(2) / recv(2) - Zephyr lacks recvmsg atm
		 */

		memset(&msghdr, 0, sizeof(msghdr));
		msghdr.msg_iov = &iovec;
		msghdr.msg_iovlen = 1;
		iovec.iov_base = (void *)expected_msg;
		iovec.iov_len = expected_msg_len;

<<<<<<< HEAD
		res = sendmsg(sv[i], &msghdr, 0);
=======
		res = sendmsg(fixture->sv[i], &msghdr, 0);
>>>>>>> 01478ffa5f76283e4556b4b7585875d50d82484d

		zassert_not_equal(res, -1, "sendmsg() failed: %d", errno);
		actual_msg_len = res;
		zassert_equal(actual_msg_len, expected_msg_len,
				  "did not sendmsg entire message");

<<<<<<< HEAD
		res = recv(sv[(!i) & 1], actual_msg, sizeof(actual_msg), 0);
=======
		res = recv(fixture->sv[(!i) & 1], actual_msg, sizeof(actual_msg), 0);
>>>>>>> 01478ffa5f76283e4556b4b7585875d50d82484d

		zassert_not_equal(res, -1, "recv() failed: %d", errno);
		actual_msg_len = res;
		zassert_equal(actual_msg_len, expected_msg_len,
			      "wrong return value");

		zassert_true(strncmp(expected_msg, actual_msg,
			actual_msg_len) == 0,
			"the wrong message was passed through the socketpair");
	}
<<<<<<< HEAD

	res = close(sv[0]);
	zassert_equal(res, 0, "close failed");

	res = close(sv[1]);
	zassert_equal(res, 0, "close failed");
}

ZTEST_USER(net_socketpair, test_AF_LOCAL_SOCK_STREAM_0)
{
	happy_path(
=======
}

ZTEST_USER_F(net_socketpair, test_AF_LOCAL_SOCK_STREAM_0)
{
	happy_path(
		fixture,
>>>>>>> 01478ffa5f76283e4556b4b7585875d50d82484d
		AF_LOCAL, "AF_LOCAL",
		SOCK_STREAM, "SOCK_STREAM",
		0, "0"
	);
}

<<<<<<< HEAD
ZTEST_USER(net_socketpair, test_AF_UNIX_SOCK_STREAM_0)
{
	happy_path(
=======
ZTEST_USER_F(net_socketpair, test_AF_UNIX_SOCK_STREAM_0)
{
	happy_path(
		fixture,
>>>>>>> 01478ffa5f76283e4556b4b7585875d50d82484d
		AF_UNIX, "AF_UNIX",
		SOCK_STREAM, "SOCK_STREAM",
		0, "0"
	);
}
```

## src/nonblock.c
```c
/*
 * Copyright (c) 2020 Friedt Professional Engineering Services, Inc
 *
 * SPDX-License-Identifier: Apache-2.0
 */

#include "_main.h"

<<<<<<< HEAD
ZTEST_USER(net_socketpair, test_write_nonblock)
{
	int res;
	int sv[2] = {-1, -1};

	res = socketpair(AF_UNIX, SOCK_STREAM, 0, sv);
	zassert_equal(res, 0, "socketpair() failed: %d", errno);
=======
ZTEST_USER_F(net_socketpair, test_write_nonblock)
{
	int res;
>>>>>>> 01478ffa5f76283e4556b4b7585875d50d82484d

	for (size_t i = 0; i < 2; ++i) {
		/* first, fill up the buffer */
		for (size_t k = 0; k < CONFIG_NET_SOCKETPAIR_BUFFER_SIZE;
			++k) {
<<<<<<< HEAD
			res = send(sv[i], "x", 1, 0);
=======
			res = send(fixture->sv[i], "x", 1, 0);
>>>>>>> 01478ffa5f76283e4556b4b7585875d50d82484d
			zassert_equal(res, 1, "send() failed: %d", errno);
		}

		/* then set the O_NONBLOCK flag */
<<<<<<< HEAD
		res = fcntl(sv[i], F_GETFL, 0);
		zassert_not_equal(res, -1, "fcntl() failed: %d", i, errno);

		res = fcntl(sv[i], F_SETFL, res | O_NONBLOCK);
		zassert_not_equal(res, -1, "fcntl() failed: %d", i, errno);

		/* then, try to write one more byte */
		res = send(sv[i], "x", 1, 0);
=======
		res = fcntl(fixture->sv[i], F_GETFL, 0);
		zassert_not_equal(res, -1, "fcntl() failed: %d", i, errno);

		res = fcntl(fixture->sv[i], F_SETFL, res | O_NONBLOCK);
		zassert_not_equal(res, -1, "fcntl() failed: %d", i, errno);

		/* then, try to write one more byte */
		res = send(fixture->sv[i], "x", 1, 0);
>>>>>>> 01478ffa5f76283e4556b4b7585875d50d82484d
		zassert_equal(res, -1, "expected send to fail");
		zassert_equal(errno, EAGAIN, "errno: expected: EAGAIN "
			"actual: %d", errno);
	}
<<<<<<< HEAD

	close(sv[0]);
	close(sv[1]);
}

ZTEST_USER(net_socketpair, test_read_nonblock)
{
	int res;
	int sv[2] = {-1, -1};
	char c;

	res = socketpair(AF_UNIX, SOCK_STREAM, 0, sv);
	zassert_equal(res, 0, "socketpair() failed: %d", errno);

	for (size_t i = 0; i < 2; ++i) {
		/* set the O_NONBLOCK flag */
		res = fcntl(sv[i], F_GETFL, 0);
		zassert_not_equal(res, -1, "fcntl() failed: %d", i, errno);

		res = fcntl(sv[i], F_SETFL, res | O_NONBLOCK);
		zassert_not_equal(res, -1, "fcntl() failed: %d", i, errno);

		/* then, try to read one byte */
		res = recv(sv[i], &c, 1, 0);
=======
}

ZTEST_USER_F(net_socketpair, test_read_nonblock)
{
	int res;
	char c;

	for (size_t i = 0; i < 2; ++i) {
		/* set the O_NONBLOCK flag */
		res = fcntl(fixture->sv[i], F_GETFL, 0);
		zassert_not_equal(res, -1, "fcntl() failed: %d", i, errno);

		res = fcntl(fixture->sv[i], F_SETFL, res | O_NONBLOCK);
		zassert_not_equal(res, -1, "fcntl() failed: %d", i, errno);

		/* then, try to read one byte */
		res = recv(fixture->sv[i], &c, 1, 0);
>>>>>>> 01478ffa5f76283e4556b4b7585875d50d82484d
		zassert_equal(res, -1, "expected recv() to fail");
		zassert_equal(errno, EAGAIN, "errno: expected: EAGAIN "
			"actual: %d", errno);
	}
<<<<<<< HEAD

	close(sv[0]);
	close(sv[1]);
=======
>>>>>>> 01478ffa5f76283e4556b4b7585875d50d82484d
}
```

## src/poll.c
```c
/*
 * Copyright (c) 2020 Friedt Professional Engineering Services, Inc
 *
 * SPDX-License-Identifier: Apache-2.0
 */

#include "_main.h"

struct ctx {
	bool should_write;
<<<<<<< HEAD
	int fd;
=======
	int *fd;
>>>>>>> 01478ffa5f76283e4556b4b7585875d50d82484d
	k_timeout_t delay;
};
static ZTEST_BMEM struct ctx ctx;
static ZTEST_BMEM struct k_work work;

/*
 * Timeout should work the same for blocking & non-blocking threads
 *
 *   - no bytes available to read after timeout, r: 0 (timeout)
 *   - no bytes available to write after timeout, r: 0 (timeout)
 */

<<<<<<< HEAD
static void test_socketpair_poll_timeout_common(int sv[2])
{
	int res;

	struct pollfd fds[1];

	memset(fds, 0, sizeof(fds));
	fds[0].fd = sv[0];
=======
static void test_socketpair_poll_timeout_common(struct net_socketpair_fixture *fixture)
{
	int res;
	struct pollfd fds[1];

	memset(fds, 0, sizeof(fds));
	fds[0].fd = fixture->sv[0];
>>>>>>> 01478ffa5f76283e4556b4b7585875d50d82484d
	fds[0].events |= POLLIN;
	res = poll(fds, 1, 1);
	zassert_equal(res, 0, "poll: expected: 0 actual: %d", res);

	for (size_t i = 0; i < CONFIG_NET_SOCKETPAIR_BUFFER_SIZE; ++i) {
<<<<<<< HEAD
		res = send(sv[0], "x", 1, 0);
=======
		res = send(fixture->sv[0], "x", 1, 0);
>>>>>>> 01478ffa5f76283e4556b4b7585875d50d82484d
		zassert_equal(res, 1, "send() failed: %d", res);
	}

	memset(fds, 0, sizeof(fds));
<<<<<<< HEAD
	fds[0].fd = sv[0];
	fds[0].events |= POLLOUT;
	res = poll(fds, 1, 1);
	zassert_equal(res, 0, "poll: expected: 0 actual: %d", res);

	close(sv[0]);
	close(sv[1]);
}

ZTEST_USER(net_socketpair, test_poll_timeout)
{
	int sv[2] = {-1, -1};
	int res = socketpair(AF_UNIX, SOCK_STREAM, 0, sv);

	zassert_not_equal(res, -1, "socketpair failed: %d", errno);

	test_socketpair_poll_timeout_common(sv);
}

/* O_NONBLOCK should have no affect on poll(2) */
ZTEST_USER(net_socketpair, test_poll_timeout_nonblocking)
{
	int sv[2] = {-1, -1};
	int res = socketpair(AF_UNIX, SOCK_STREAM, 0, sv);

	zassert_not_equal(res, -1, "socketpair failed: %d", errno);

	res = fcntl(sv[0], F_GETFL, 0);
=======
	fds[0].fd = fixture->sv[0];
	fds[0].events |= POLLOUT;
	res = poll(fds, 1, 1);
	zassert_equal(res, 0, "poll: expected: 0 actual: %d", res);
}

ZTEST_USER_F(net_socketpair, test_poll_timeout)
{
	test_socketpair_poll_timeout_common(fixture);
}

/* O_NONBLOCK should have no affect on poll(2) */
ZTEST_USER_F(net_socketpair, test_poll_timeout_nonblocking)
{
	int res;

	res = fcntl(fixture->sv[0], F_GETFL, 0);
>>>>>>> 01478ffa5f76283e4556b4b7585875d50d82484d
	zassert_not_equal(res, -1, "fcntl failed: %d", errno);

	int flags = res;

<<<<<<< HEAD
	res = fcntl(sv[0], F_SETFL, O_NONBLOCK | flags);
	zassert_not_equal(res, -1, "fcntl failed: %d", errno);

	res = fcntl(sv[1], F_SETFL, O_NONBLOCK | flags);
	zassert_not_equal(res, -1, "fcntl failed: %d", errno);

	test_socketpair_poll_timeout_common(sv);
}

static void close_fun(struct k_work *work)
{
	(void)work;
=======
	res = fcntl(fixture->sv[0], F_SETFL, O_NONBLOCK | flags);
	zassert_not_equal(res, -1, "fcntl failed: %d", errno);

	res = fcntl(fixture->sv[1], F_SETFL, O_NONBLOCK | flags);
	zassert_not_equal(res, -1, "fcntl failed: %d", errno);

	test_socketpair_poll_timeout_common(fixture);
}

static void close_fun(struct k_work *w)
{
	(void)w;
>>>>>>> 01478ffa5f76283e4556b4b7585875d50d82484d

	if (!(K_TIMEOUT_EQ(ctx.delay, K_NO_WAIT)
		|| K_TIMEOUT_EQ(ctx.delay, K_FOREVER))) {
		k_sleep(ctx.delay);
	}

<<<<<<< HEAD
	LOG_DBG("about to close fd %d", ctx.fd);
	close(ctx.fd);
=======
	LOG_DBG("about to close fd %d", *ctx.fd);
	close(*ctx.fd);
	*ctx.fd = -1;
>>>>>>> 01478ffa5f76283e4556b4b7585875d50d82484d
}

/*
 * Hangup should cause the following behaviour
 *   - close remote fd while the local fd is blocking in poll. r: 1,
 *     POLLIN, read -> r: 0, errno: 0 -> EOF
 *   - close remote fd while the local fd is blocking in poll. r: 1,
 *     POLLOUT, write -> r: -1, errno: EPIPE.
 */
<<<<<<< HEAD
ZTEST(net_socketpair, test_poll_close_remote_end_POLLIN)
=======
ZTEST_F(net_socketpair, test_poll_close_remote_end_POLLIN)
>>>>>>> 01478ffa5f76283e4556b4b7585875d50d82484d
{
	int res;
	char c;
	struct pollfd fds[1];

<<<<<<< HEAD
	int sv[2] = {-1, -1};

	res = socketpair(AF_UNIX, SOCK_STREAM, 0, sv);
	zassert_not_equal(res, -1, "socketpair() failed: %d", errno);

=======
>>>>>>> 01478ffa5f76283e4556b4b7585875d50d82484d
	/*
	 * poll until there are bytes to read.
	 * But rather than writing, close the other end of the channel
	 */

	memset(fds, 0, sizeof(fds));
<<<<<<< HEAD
	fds[0].fd = sv[0];
	fds[0].events |= POLLIN;

	memset(&ctx, 0, sizeof(ctx));
	ctx.fd = sv[1];
=======
	fds[0].fd = fixture->sv[0];
	fds[0].events |= POLLIN;

	memset(&ctx, 0, sizeof(ctx));
	ctx.fd = &fixture->sv[1];
>>>>>>> 01478ffa5f76283e4556b4b7585875d50d82484d
	ctx.delay = K_MSEC(1000);

	LOG_DBG("scheduling work");
	k_work_init(&work, close_fun);
	k_work_submit(&work);

	res = poll(fds, 1, -1);
	zassert_equal(res, 1, "poll() failed: %d", res);
	zassert_equal(fds[0].revents & POLLIN, POLLIN, "POLLIN not set");

<<<<<<< HEAD
	res = recv(sv[0], &c, 1, 0);
	zassert_equal(res, 0, "read did not return EOF");

	close(sv[0]);
}

ZTEST(net_socketpair, test_poll_close_remote_end_POLLOUT)
=======
	res = recv(fixture->sv[0], &c, 1, 0);
	zassert_equal(res, 0, "read did not return EOF");
}

ZTEST_F(net_socketpair, test_poll_close_remote_end_POLLOUT)
>>>>>>> 01478ffa5f76283e4556b4b7585875d50d82484d
{
	int res;
	struct pollfd fds[1];

<<<<<<< HEAD
	int sv[2] = {-1, -1};

=======
>>>>>>> 01478ffa5f76283e4556b4b7585875d50d82484d
	/*
	 * Fill up the remote q and then poll until write space is available.
	 * But rather than reading, close the other end of the channel
	 */

<<<<<<< HEAD
	res = socketpair(AF_UNIX, SOCK_STREAM, 0, sv);
	zassert_not_equal(res, -1, "socketpair() failed: %d", errno);

	for (size_t i = 0; i < CONFIG_NET_SOCKETPAIR_BUFFER_SIZE; ++i) {
		res = send(sv[0], "x", 1, 0);
=======
	res = socketpair(AF_UNIX, SOCK_STREAM, 0, fixture->sv);
	zassert_not_equal(res, -1, "socketpair() failed: %d", errno);

	for (size_t i = 0; i < CONFIG_NET_SOCKETPAIR_BUFFER_SIZE; ++i) {
		res = send(fixture->sv[0], "x", 1, 0);
>>>>>>> 01478ffa5f76283e4556b4b7585875d50d82484d
		zassert_equal(res, 1, "send failed: %d", res);
	}

	memset(fds, 0, sizeof(fds));
<<<<<<< HEAD
	fds[0].fd = sv[0];
	fds[0].events |= POLLOUT;

	memset(&ctx, 0, sizeof(ctx));
	ctx.fd = sv[1];
=======
	fds[0].fd = fixture->sv[0];
	fds[0].events |= POLLOUT;

	memset(&ctx, 0, sizeof(ctx));
	ctx.fd = &fixture->sv[1];
>>>>>>> 01478ffa5f76283e4556b4b7585875d50d82484d
	ctx.delay = K_MSEC(1000);

	LOG_DBG("scheduling work");
	k_work_init(&work, close_fun);
	k_work_submit(&work);

	res = poll(fds, 1, -1);
	zassert_equal(res, 1, "poll() failed: %d", res);
	zassert_equal(fds[0].revents & POLLHUP, POLLHUP, "POLLHUP not set");

<<<<<<< HEAD
	res = send(sv[0], "x", 1, 0);
	zassert_equal(res, -1, "send(): expected: -1 actual: %d", res);
	zassert_equal(errno, EPIPE, "errno: expected: EPIPE actual: %d", errno);

	close(sv[0]);
=======
	res = send(fixture->sv[0], "x", 1, 0);
	zassert_equal(res, -1, "send(): expected: -1 actual: %d", res);
	zassert_equal(errno, EPIPE, "errno: expected: EPIPE actual: %d", errno);
>>>>>>> 01478ffa5f76283e4556b4b7585875d50d82484d
}

/*
 * Data available immediately
 *   - even with a timeout value of 0 us, poll should return immediately with
 *     a value of 1 (for either read or write cases)
 *   - even with a timeout value of 0us, poll should return immediately with
 *     a value of 2 if both read and write are available
 */
<<<<<<< HEAD
ZTEST_USER(net_socketpair, test_poll_immediate_data)
{
	int sv[2] = {-1, -1};
	int res;

	struct pollfd fds[2];

	res = socketpair(AF_UNIX, SOCK_STREAM, 0, sv);
	zassert_not_equal(res, -1, "socketpair() failed: %d", errno);

	memset(fds, 0, sizeof(fds));
	fds[0].fd = sv[0];
=======
ZTEST_USER_F(net_socketpair, test_poll_immediate_data)
{
	int res;
	struct pollfd fds[2];

	memset(fds, 0, sizeof(fds));
	fds[0].fd = fixture->sv[0];
>>>>>>> 01478ffa5f76283e4556b4b7585875d50d82484d
	fds[0].events |= POLLOUT;
	res = poll(fds, 1, 0);
	zassert_not_equal(res, -1, "poll() failed: %d", errno);
	zassert_equal(res, 1, "poll(): expected: 1 actual: %d", res);
	zassert_not_equal(fds[0].revents & POLLOUT, 0, "POLLOUT not set");

<<<<<<< HEAD
	res = send(sv[0], "x", 1, 0);
=======
	res = send(fixture->sv[0], "x", 1, 0);
>>>>>>> 01478ffa5f76283e4556b4b7585875d50d82484d
	zassert_not_equal(res, -1, "send() failed: %d", errno);
	zassert_equal(res, 1, "write(): expected: 1 actual: %d", res);

	memset(fds, 0, sizeof(fds));
<<<<<<< HEAD
	fds[0].fd = sv[1];
=======
	fds[0].fd = fixture->sv[1];
>>>>>>> 01478ffa5f76283e4556b4b7585875d50d82484d
	fds[0].events |= POLLIN;
	res = poll(fds, 1, 0);
	zassert_not_equal(res, -1, "poll() failed: %d", errno);
	zassert_equal(res, 1, "poll(): expected: 1 actual: %d", res);
	zassert_not_equal(fds[0].revents & POLLIN, 0, "POLLIN not set");

	memset(fds, 0, sizeof(fds));
<<<<<<< HEAD
	fds[0].fd = sv[0];
	fds[0].events |= POLLOUT;
	fds[1].fd = sv[1];
=======
	fds[0].fd = fixture->sv[0];
	fds[0].events |= POLLOUT;
	fds[1].fd = fixture->sv[1];
>>>>>>> 01478ffa5f76283e4556b4b7585875d50d82484d
	fds[1].events |= POLLIN;
	res = poll(fds, 2, 0);
	zassert_not_equal(res, -1, "poll() failed: %d", errno);
	zassert_equal(res, 2, "poll(): expected: 1 actual: %d", res);
	zassert_not_equal(fds[0].revents & POLLOUT, 0, "POLLOUT not set");
	zassert_not_equal(fds[1].revents & POLLIN, 0, "POLLIN not set");
<<<<<<< HEAD

	close(sv[0]);
	close(sv[1]);
}

static void rw_fun(struct k_work *work)
{
	(void)work;
=======
}

static void rw_fun(struct k_work *w)
{
	(void)w;
>>>>>>> 01478ffa5f76283e4556b4b7585875d50d82484d

	int res;
	char c;

	if (!(K_TIMEOUT_EQ(ctx.delay, K_NO_WAIT)
		|| K_TIMEOUT_EQ(ctx.delay, K_FOREVER))) {
		k_sleep(ctx.delay);
	}

	if (ctx.should_write) {
		LOG_DBG("about to write 1 byte");
<<<<<<< HEAD
		res = send(ctx.fd, "x", 1, 0);
=======
		res = send(*ctx.fd, "x", 1, 0);
>>>>>>> 01478ffa5f76283e4556b4b7585875d50d82484d
		if (-1 == res) {
			LOG_DBG("send() failed: %d", errno);
		} else {
			LOG_DBG("wrote 1 byte");
		}
	} else {
		LOG_DBG("about to read 1 byte");
<<<<<<< HEAD
		res = recv(ctx.fd, &c, 1, 0);
=======
		res = recv(*ctx.fd, &c, 1, 0);
>>>>>>> 01478ffa5f76283e4556b4b7585875d50d82484d
		if (-1 == res) {
			LOG_DBG("recv() failed: %d", errno);
		} else {
			LOG_DBG("read 1 byte");
		}
	}
}

/*
 * Data only available but after some short period
 *   - say there is a timeout value of 5 s, poll should return immediately
 *     with the a value of 1 (for either read or write cases)
 */
<<<<<<< HEAD
ZTEST(net_socketpair, test_poll_delayed_data)
{
	int sv[2] = {-1, -1};
	int res;

	struct pollfd fds[1];

	res = socketpair(AF_UNIX, SOCK_STREAM, 0, sv);
	zassert_not_equal(res, -1, "socketpair() failed: %d", errno);

	memset(fds, 0, sizeof(fds));
	fds[0].fd = sv[0];
	fds[0].events |= POLLIN;

	memset(&ctx, 0, sizeof(ctx));
	ctx.fd = sv[1];
=======
ZTEST_F(net_socketpair, test_poll_delayed_data)
{
	int res;
	struct pollfd fds[1];

	memset(fds, 0, sizeof(fds));
	fds[0].fd = fixture->sv[0];
	fds[0].events |= POLLIN;

	memset(&ctx, 0, sizeof(ctx));
	ctx.fd = &fixture->sv[1];
>>>>>>> 01478ffa5f76283e4556b4b7585875d50d82484d
	ctx.should_write = true;
	ctx.delay = K_MSEC(100);

	LOG_DBG("scheduling work");
	k_work_init(&work, rw_fun);
	k_work_submit(&work);

	res = poll(fds, 1, 5000);
	zassert_not_equal(res, -1, "poll() failed: %d", errno);
	zassert_equal(res, 1, "poll(): expected: 1 actual: %d", res);
	zassert_not_equal(fds[0].revents & POLLIN, 0, "POLLIN not set");

	for (size_t i = 0; i < CONFIG_NET_SOCKETPAIR_BUFFER_SIZE; ++i) {
<<<<<<< HEAD
		res = send(sv[0], "x", 1, 0);
=======
		res = send(fixture->sv[0], "x", 1, 0);
>>>>>>> 01478ffa5f76283e4556b4b7585875d50d82484d
		zassert_equal(res, 1, "send() failed: %d", res);
	}

	memset(fds, 0, sizeof(fds));
<<<<<<< HEAD
	fds[0].fd = sv[0];
	fds[0].events |= POLLOUT;

	memset(&ctx, 0, sizeof(ctx));
	ctx.fd = sv[1];
=======
	fds[0].fd = fixture->sv[0];
	fds[0].events |= POLLOUT;

	memset(&ctx, 0, sizeof(ctx));
	ctx.fd = &fixture->sv[1];
>>>>>>> 01478ffa5f76283e4556b4b7585875d50d82484d
	ctx.should_write = false;
	ctx.delay = K_MSEC(100);

	LOG_DBG("scheduling work");
	k_work_init(&work, rw_fun);
	k_work_submit(&work);

	res = poll(fds, 1, 5000);
	zassert_not_equal(res, -1, "poll() failed: %d", errno);
	zassert_equal(res, 1, "poll(): expected: 1 actual: %d", res);
	zassert_not_equal(fds[0].revents & POLLOUT, 0, "POLLOUT was not set");
<<<<<<< HEAD

	close(sv[0]);
	close(sv[1]);
=======
>>>>>>> 01478ffa5f76283e4556b4b7585875d50d82484d
}

/*
 * Verify that POLLIN is correctly signalled
 *   - right after socket creation, POLLIN should not be reported
 *   - after data is written to a remote socket, POLLIN should be reported, even
 *     if the poll was called after the data was written
 *   - after reading data from a remote socket, POLLIN shouldn't be reported
 */
<<<<<<< HEAD
ZTEST_USER(net_socketpair, test_poll_signalling_POLLIN)
{
	int sv[2] = {-1, -1};
	int res;
	char c;
	int64_t timestamp, delta;

	struct pollfd fds[1];

	res = socketpair(AF_UNIX, SOCK_STREAM, 0, sv);
	zassert_not_equal(res, -1, "socketpair failed: %d", errno);

	memset(fds, 0, sizeof(fds));
	fds[0].fd = sv[1];
=======
ZTEST_USER_F(net_socketpair, test_poll_signalling_POLLIN)
{
	int res;
	char c;
	int64_t timestamp, delta;
	struct pollfd fds[1];

	memset(fds, 0, sizeof(fds));
	fds[0].fd = fixture->sv[1];
>>>>>>> 01478ffa5f76283e4556b4b7585875d50d82484d
	fds[0].events |= POLLIN;
	res = poll(fds, 1, 0);
	zassert_not_equal(res, -1, "poll failed: %d", errno);
	zassert_equal(res, 0, "poll: expected: 0 actual: %d", res);
	zassert_not_equal(fds[0].revents & POLLIN, POLLIN, "POLLIN set");

<<<<<<< HEAD
	res = send(sv[0], "x", 1, 0);
=======
	res = send(fixture->sv[0], "x", 1, 0);
>>>>>>> 01478ffa5f76283e4556b4b7585875d50d82484d
	zassert_equal(res, 1, "send failed: %d", res);

	timestamp = k_uptime_get();

	memset(fds, 0, sizeof(fds));
<<<<<<< HEAD
	fds[0].fd = sv[1];
=======
	fds[0].fd = fixture->sv[1];
>>>>>>> 01478ffa5f76283e4556b4b7585875d50d82484d
	fds[0].events |= POLLIN;
	res = poll(fds, 1, 1000);
	zassert_not_equal(res, -1, "poll failed: %d", errno);
	zassert_equal(res, 1, "poll: expected: 1 actual: %d", res);
	zassert_not_equal(fds[0].revents & POLLIN, 0, "POLLIN not set");

	delta = k_uptime_delta(&timestamp);
	zassert_true(delta < 100, "poll did not exit immediately");

<<<<<<< HEAD
	res = recv(sv[1], &c, 1, 0);
	zassert_equal(res, 1, "recv failed: %d", res);

	memset(fds, 0, sizeof(fds));
	fds[0].fd = sv[1];
=======
	res = recv(fixture->sv[1], &c, 1, 0);
	zassert_equal(res, 1, "recv failed: %d", res);

	memset(fds, 0, sizeof(fds));
	fds[0].fd = fixture->sv[1];
>>>>>>> 01478ffa5f76283e4556b4b7585875d50d82484d
	fds[0].events |= POLLIN;
	res = poll(fds, 1, 0);
	zassert_not_equal(res, -1, "poll failed: %d", errno);
	zassert_equal(res, 0, "poll: expected: 0 actual: %d", res);
	zassert_not_equal(fds[0].revents & POLLIN, POLLIN, "POLLIN set");
<<<<<<< HEAD

	close(sv[0]);
	close(sv[1]);
=======
>>>>>>> 01478ffa5f76283e4556b4b7585875d50d82484d
}

/*
 * Verify that POLLOUT is correctly signalled
 *   - right after socket creation, POLLOUT should be reported
 *   - after remote buffer is filled up, POLLOUT shouldn't be reported
 *   - after reading data from a remote socket, POLLOUT should be reported
 *     again
 */
<<<<<<< HEAD
ZTEST_USER(net_socketpair, test_poll_signalling_POLLOUT)
{
	int sv[2] = {-1, -1};
	int res;
	char c;
	int64_t timestamp, delta;

	struct pollfd fds[1];

	res = socketpair(AF_UNIX, SOCK_STREAM, 0, sv);
	zassert_not_equal(res, -1, "socketpair failed: %d", errno);

	timestamp = k_uptime_get();

	memset(fds, 0, sizeof(fds));
	fds[0].fd = sv[0];
=======
ZTEST_USER_F(net_socketpair, test_poll_signalling_POLLOUT)
{
	int res;
	char c;
	int64_t timestamp, delta;
	struct pollfd fds[1];

	timestamp = k_uptime_get();

	memset(fds, 0, sizeof(fds));
	fds[0].fd = fixture->sv[0];
>>>>>>> 01478ffa5f76283e4556b4b7585875d50d82484d
	fds[0].events |= POLLOUT;
	res = poll(fds, 1, 1000);
	zassert_not_equal(res, -1, "poll failed: %d", errno);
	zassert_equal(res, 1, "poll: expected: 1 actual: %d", res);
	zassert_not_equal(fds[0].revents & POLLOUT, 0, "POLLOUT not set");

	delta = k_uptime_delta(&timestamp);
	zassert_true(delta < 100, "poll did not exit immediately");

	/* Fill up the remote buffer */
	for (size_t i = 0; i < CONFIG_NET_SOCKETPAIR_BUFFER_SIZE; ++i) {
<<<<<<< HEAD
		res = send(sv[0], "x", 1, 0);
=======
		res = send(fixture->sv[0], "x", 1, 0);
>>>>>>> 01478ffa5f76283e4556b4b7585875d50d82484d
		zassert_equal(res, 1, "send() failed: %d", res);
	}

	memset(fds, 0, sizeof(fds));
<<<<<<< HEAD
	fds[0].fd = sv[0];
=======
	fds[0].fd = fixture->sv[0];
>>>>>>> 01478ffa5f76283e4556b4b7585875d50d82484d
	fds[0].events |= POLLOUT;
	res = poll(fds, 1, 0);
	zassert_not_equal(res, -1, "poll failed: %d", errno);
	zassert_equal(res, 0, "poll: expected: 0 actual: %d", res);
	zassert_not_equal(fds[0].revents & POLLOUT, POLLOUT, "POLLOUT is set");

<<<<<<< HEAD
	res = recv(sv[1], &c, 1, 0);
=======
	res = recv(fixture->sv[1], &c, 1, 0);
>>>>>>> 01478ffa5f76283e4556b4b7585875d50d82484d
	zassert_equal(res, 1, "recv() failed: %d", res);

	timestamp = k_uptime_get();

	memset(fds, 0, sizeof(fds));
<<<<<<< HEAD
	fds[0].fd = sv[0];
=======
	fds[0].fd = fixture->sv[0];
>>>>>>> 01478ffa5f76283e4556b4b7585875d50d82484d
	fds[0].events |= POLLOUT;
	res = poll(fds, 1, 1000);
	zassert_not_equal(res, -1, "poll failed: %d", errno);
	zassert_equal(res, 1, "poll: expected: 1 actual: %d", res);
	zassert_not_equal(fds[0].revents & POLLOUT, 0, "POLLOUT not set");

	delta = k_uptime_delta(&timestamp);
	zassert_true(delta < 100, "poll did not exit immediately");
<<<<<<< HEAD

	close(sv[0]);
	close(sv[1]);
=======
>>>>>>> 01478ffa5f76283e4556b4b7585875d50d82484d
}
```

## src/unsupported_calls.c
```c
/*
 * Copyright (c) 2020 Friedt Professional Engineering Services, Inc
 *
 * SPDX-License-Identifier: Apache-2.0
 */

#include "_main.h"

<<<<<<< HEAD
ZTEST_USER(net_socketpair, test_unsupported_calls)
{
	int res;
	int sv[2] = {-1, -1};
=======
ZTEST_USER_F(net_socketpair, test_unsupported_calls)
{
	int res;
>>>>>>> 01478ffa5f76283e4556b4b7585875d50d82484d
	struct sockaddr_un addr = {
		.sun_family = AF_UNIX,
	};
	socklen_t len = sizeof(addr);

<<<<<<< HEAD
	res = socketpair(AF_UNIX, SOCK_STREAM, 0, sv);
	zassert_equal(res, 0,
		"socketpair(AF_UNIX, SOCK_STREAM, 0, sv) failed");


	for (size_t i = 0; i < 2; ++i) {

		res = bind(sv[i], (struct sockaddr *)&addr, len);
=======
	for (size_t i = 0; i < 2; ++i) {

		res = bind(fixture->sv[i], (struct sockaddr *)&addr, len);
>>>>>>> 01478ffa5f76283e4556b4b7585875d50d82484d
		zassert_equal(res, -1,
			"bind should fail on a socketpair endpoint");
		zassert_equal(errno, EISCONN,
			"bind should set errno to EISCONN");

<<<<<<< HEAD
		res = connect(sv[i], (struct sockaddr *)&addr, len);
=======
		res = connect(fixture->sv[i], (struct sockaddr *)&addr, len);
>>>>>>> 01478ffa5f76283e4556b4b7585875d50d82484d
		zassert_equal(res, -1,
			"connect should fail on a socketpair endpoint");
		zassert_equal(errno, EISCONN,
			"connect should set errno to EISCONN");

<<<<<<< HEAD
		res = listen(sv[i], 1);
=======
		res = listen(fixture->sv[i], 1);
>>>>>>> 01478ffa5f76283e4556b4b7585875d50d82484d
		zassert_equal(res, -1,
			"listen should fail on a socketpair endpoint");
		zassert_equal(errno, EINVAL,
			"listen should set errno to EINVAL");

<<<<<<< HEAD
		res = accept(sv[i], (struct sockaddr *)&addr, &len);
=======
		res = accept(fixture->sv[i], (struct sockaddr *)&addr, &len);
>>>>>>> 01478ffa5f76283e4556b4b7585875d50d82484d
		zassert_equal(res, -1,
			"accept should fail on a socketpair endpoint");
		zassert_equal(errno, EOPNOTSUPP,
			"accept should set errno to EOPNOTSUPP");
	}
<<<<<<< HEAD

	res = close(sv[0]);
	zassert_equal(res, 0, "close failed");

	res = close(sv[1]);
	zassert_equal(res, 0, "close failed");
=======
>>>>>>> 01478ffa5f76283e4556b4b7585875d50d82484d
}
```
